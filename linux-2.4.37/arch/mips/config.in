## linux-2.4.37/arch/mips/config.in
```kconfig
#
# For a description of the syntax of this configuration file,
# see Documentation/kbuild/config-language.txt.
#
define_bool CONFIG_MIPS y
define_bool CONFIG_MIPS32 y
define_bool CONFIG_MIPS64 n

source arch/mips/config-shared.in

mainmenu_option next_comment
comment 'Kernel Security'
bool 'Grsecurity' CONFIG_GRKERNSEC
if [ "$CONFIG_GRKERNSEC" = "y" ]; then
        source grsecurity/Config.in
fi
endmenu
```

## linux-2.4.37/arch/mips64/config.in
```kconfig
#
# For a description of the syntax of this configuration file,
# see Documentation/kbuild/config-language.txt.
#
define_bool CONFIG_MIPS y
define_bool CONFIG_MIPS32 n
define_bool CONFIG_MIPS64 y

source arch/mips/config-shared.in

mainmenu_option next_comment
comment 'Kernel Security'
bool 'Grsecurity' CONFIG_GRKERNSEC
if [ "$CONFIG_GRKERNSEC" = "y" ]; then
        source grsecurity/Config.in
fi
endmenu
```
